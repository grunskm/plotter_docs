
#include <Servo.h>

#define x_step 4
#define x_dir 5
#define y_step 2
#define y_dir 3

const int data[] PROGMEM = 
{0,0,0,0,0,0,0,0,0,0,0,0,0,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0,0};

const int buttonPin = 10;
int buttonState = 0;
bool printAborted = false;

Servo servo;
bool pen_engaged;

int pen_x = 0;
int pen_y = 0;

// max width: 32000
// max height: 28000

//int width = 10000; //X-axis (rail)
//int height = 10000; //Y-axis (board)
//int x_margin = 0;
//int y_margin = 0;

void setup() {
  Serial.begin(9600);

  servo.attach(9);
  raise_pen();
  delay(2000);

  pinMode(x_step, OUTPUT);
  pinMode(x_dir, OUTPUT);
  pinMode(y_step, OUTPUT);
  pinMode(y_dir, OUTPUT);

  pinMode(buttonPin, INPUT);

  //perimeter();

  int rows = 80;
  int cols = 64;
  
  int k = 0;
  int last_point = 0;

  int space = 350;
  int off = 266;
  raise_pen();
  
  for( int i=0; i<rows; i++){
    if(printAborted==false){
      moveToPoint(0+off,i*space+off);
      
      if(pgm_read_byte(data+k)==1){
        lower_pen();
        last_point = 1;
      }else{
        raise_pen();
        last_point = 0;
      }
    
    for( int e=0; e<cols; e++){
      if(printAborted==false){
        
        int data_point = pgm_read_byte(data+k);
  
        if(data_point != last_point&& pen_engaged== true){
         moveToPoint((e-1)*space+off,i*space+off);
         toggle_pen();
         last_point = data_point;
        }else if(data_point != last_point){
         moveToPoint(e*space+off,i*space+off);
         toggle_pen();
         last_point = data_point;
        }
        k++;
      }else{break;}
    }
    moveToPoint((cols-1)*space+off,i*space+off);
    raise_pen();
    }else{break;}
  }

  returnToHome();
  
  k = 0;
  last_point = 0;

  for( int i=0; i<cols; i++){
    if(printAborted==false){
      moveToPoint(i*space+off, 0+off);
      if(pgm_read_byte(data+i)==1){
        lower_pen();
        last_point = 1;
      }else{
        raise_pen();
        last_point = 0;
      }
    
    for( int e=0; e<rows; e++){
      if(printAborted==false){
        k = (e*cols)+i;
        int data_point = pgm_read_byte(data+k);
  
        if(data_point != last_point && pen_engaged== true){
         moveToPoint(i*space+off,(e-1)*space+off);
         toggle_pen();
         last_point = data_point;
        }else if(data_point != last_point){
         moveToPoint(i*space+off,e*space+off);
         toggle_pen();
         last_point = data_point; 
        }
        
      }else{break;}
    }
    moveToPoint(i*space+off,(rows-1)*space+off);
    raise_pen();
    }else{break;}
  }
 

  returnToHome();
}


void loop() {

}
