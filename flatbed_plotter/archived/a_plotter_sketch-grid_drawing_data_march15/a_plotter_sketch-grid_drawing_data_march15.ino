
#include <Servo.h>

#define x_step 4
#define x_dir 5
#define y_step 2
#define y_dir 3

const int rows[] PROGMEM = 
{1,1,1,1,1,1,1,1,1,1,1,1,1,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1,1};

const int buttonPin = 10;
int buttonState = 0;
bool printAborted = false;

Servo servo;
bool pen_engaged;

int pen_x = 0;
int pen_y = 0;

// max width: 32000
// max height: 28000

//int width = 10000; //X-axis (rail)
//int height = 10000; //Y-axis (board)
//int x_margin = 0;
//int y_margin = 0;

void setup() {
  Serial.begin(9600);

  servo.attach(9);
  raise_pen();
  delay(2000);

  pinMode(x_step, OUTPUT);
  pinMode(x_dir, OUTPUT);
  pinMode(y_step, OUTPUT);
  pinMode(y_dir, OUTPUT);

  pinMode(buttonPin, INPUT);

  //perimeter();
  
  int k = 0;
  int last_point = 0;

  int space = 400;
  raise_pen();
  
  for( int i=0; i<64; i++){
    if(printAborted==false){
      moveToPoint(0,i*space);
      
      if(pgm_read_byte(rows+k)==1){
        lower_pen();
        last_point = 1;
      }else{
        raise_pen();
        last_point = 0;
      }
    
    for( int e=0; e<64; e++){
      if(printAborted==false){
        
        int data_point = pgm_read_byte(rows+k);
  
        if(data_point != last_point){
         moveToPoint(e*space,i*space);
         toggle_pen();
         last_point = data_point;
        }
        k++;
      }else{break;}
    }
    moveToPoint(64*space,i*space);
    raise_pen();
    }else{break;}
  }

  returnToHome();
  
  k = 0;
  last_point = 0;

  for( int i=0; i<64; i++){
    if(printAborted==false){
      moveToPoint(i*space, 0);
      if(pgm_read_byte(rows+i)==1){
        lower_pen();
        last_point = 1;
      }else{
        raise_pen();
        last_point = 0;
      }
    
    for( int e=0; e<64; e++){
      if(printAborted==false){
        k = (e*64)+i;
        int data_point = pgm_read_byte(rows+k);
  
        if(data_point != last_point){
         moveToPoint(i*space,e*space);
         toggle_pen();
         last_point = data_point;
        }
        
      }else{break;}
    }
    moveToPoint(i*space,64*space);
    raise_pen();
    }else{break;}
  }
 

  returnToHome();
}


void loop() {

}
