
#include <Servo.h>

#define x_step 4
#define x_dir 5
#define y_step 2
#define y_dir 3

const int rows[] PROGMEM = 
{0,0,0,0,0,0,0,0,0,0,0,0,0,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0,0};

const int buttonPin = 10;
int buttonState = 0;
bool printAborted = false;

Servo servo;
bool pen_engaged;

int pen_x = 0;
int pen_y = 0;

// max width: 32000
// max height: 28000

int width = 15000; //X-axis (rail)
int height = 10000; //Y-axis (board)
int x_margin = 0;
int y_margin = 0;


void setup() {
  Serial.begin(9600);

  servo.attach(9);
  for(int i=0;i<5;i++){
    raise_pen();
    lower_pen();
    raise_pen();
  }

  delay(2000);

  pinMode(x_step, OUTPUT);
  pinMode(x_dir, OUTPUT);
  pinMode(y_step, OUTPUT);
  pinMode(y_dir, OUTPUT);

  pinMode(buttonPin, INPUT);

  //perimeter();
  
  int space = 400;
  
  int lines = height/space;
  int hspace = 200;
 
  for(int i=0; i<lines; i++){
    if(printAborted == false){
      raise_pen();
      int x = 0;

      moveToPoint(x, i*space, 50);
      lower_pen();
      int e=0;
      while(e < 15000){
        if(printAborted == false){
        int y = i*space + sin((x+e)*0.005)*e/25;
        moveToPoint(x+e, y, 50);
        e++;
        }else{break;}
      }
    }else{break;}
  }


  returnToHome();
}


void loop() {

}
